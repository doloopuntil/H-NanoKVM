## buildroot-external/hardened-sg2002/package/hardened-c906l-tls-test/Config.in
```kconfig
config BR2_PACKAGE_HARDENED_C906L_TLS_TEST
	bool "C906L send-side TLS measurement (experiment)"
	depends on BR2_LINUX_KERNEL
	depends on BR2_riscv
	help
	  Test firmware for the C906L (ChaCha20-Poly1305 with
	  Monocypher on a shared buffer, requests over the mailbox)
	  and a kernel module that loads it, releases the core and
	  times records. Only for a measurement image; see
	  docs/development/c906l-send-tls.md.
```

## buildroot-external/hardened-sg2002/package/hnanokvm-fit-tools/Config.in
```kconfig
config BR2_PACKAGE_HOST_HNANOKVM_FIT_TOOLS
	bool "host tools for the H-NanoKVM boot FIT"
	select BR2_PACKAGE_HOST_UBOOT_TOOLS
	select BR2_PACKAGE_HOST_UBOOT_TOOLS_FIT_SUPPORT
	help
	  Builds what linux-6.18/post-image.sh needs to pack boot.itb:
	  host lz4 for the kernel and mkimage. Buildroot has no option
	  for host lz4 of its own.
```
